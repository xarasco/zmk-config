/*
 * Right half — nice!nano mounted on the OPPOSITE face of the PCB.
 *
 * This thin wrapper exists purely for devicetree ordering. A file in
 * config/*.overlay is concatenated BEFORE the shield's own overlay, so
 * &kscan0 does not exist yet there. The keymap is concatenated AFTER the
 * shield, so the override lands last and wins.
 *
 * config/lily58_right.keymap outranks config/lily58.keymap in ZMK's
 * KEYMAP_FILE search, so the shared keymap is pulled in by #include below.
 */

#include "lily58.keymap"

/*
 * Flipping a Pro Micro footprint onto the reverse face mirrors the two header
 * rows about the long axis: left-column index i now lands on the pad that
 * right-column index i used to touch.
 *
 *   D4<->D19  D5<->D18  D6<->D15  D7<->D14  D8<->D16  D9<->D10
 *
 * rows sit on pads D5,D6,D7,D8,D9           -> D18,D15,D14,D16,D10
 * cols sit on pads D10,D16,D14,D15,D18,D19  -> D9,D8,D7,D6,D5,D4
 */
&kscan0 {
    row-gpios
        = <&pro_micro 18 (GPIO_ACTIVE_HIGH | GPIO_PULL_DOWN)>
        , <&pro_micro 15 (GPIO_ACTIVE_HIGH | GPIO_PULL_DOWN)>
        , <&pro_micro 14 (GPIO_ACTIVE_HIGH | GPIO_PULL_DOWN)>
        , <&pro_micro 16 (GPIO_ACTIVE_HIGH | GPIO_PULL_DOWN)>
        , <&pro_micro 10 (GPIO_ACTIVE_HIGH | GPIO_PULL_DOWN)>
        ;

    col-gpios
        = <&pro_micro 9 GPIO_ACTIVE_HIGH>
        , <&pro_micro 8 GPIO_ACTIVE_HIGH>
        , <&pro_micro 7 GPIO_ACTIVE_HIGH>
        , <&pro_micro 6 GPIO_ACTIVE_HIGH>
        , <&pro_micro 5 GPIO_ACTIVE_HIGH>
        , <&pro_micro 4 GPIO_ACTIVE_HIGH>
        ;
};
