/*
 * Right half — controller mounted on the OPPOSITE face of the PCB.
 * Same long-axis mirror as config/lily58_left.overlay; only the column order
 * differs, because the stock right overlay lists its columns in reverse.
 *
 * Stock right cols sit on pads D10,D16,D14,D15,D18,D19 -> flipped: D9,D8,D7,D6,D5,D4
 *
 * NOTE: only apply this if the RIGHT half's controller is also flipped.
 * If only the left one is, delete this file.
 */

&kscan0 {
    row-gpios
        = <&pro_micro 18 (GPIO_ACTIVE_HIGH | GPIO_PULL_DOWN)>
        , <&pro_micro 15 (GPIO_ACTIVE_HIGH | GPIO_PULL_DOWN)>
        , <&pro_micro 14 (GPIO_ACTIVE_HIGH | GPIO_PULL_DOWN)>
        , <&pro_micro 16 (GPIO_ACTIVE_HIGH | GPIO_PULL_DOWN)>
        , <&pro_micro 10 (GPIO_ACTIVE_HIGH | GPIO_PULL_DOWN)>
        ;

    col-gpios
        = <&pro_micro 9 GPIO_ACTIVE_HIGH>
        , <&pro_micro 8 GPIO_ACTIVE_HIGH>
        , <&pro_micro 7 GPIO_ACTIVE_HIGH>
        , <&pro_micro 6 GPIO_ACTIVE_HIGH>
        , <&pro_micro 5 GPIO_ACTIVE_HIGH>
        , <&pro_micro 4 GPIO_ACTIVE_HIGH>
        ;
};
