/*
 * Left half — controller mounted on the OPPOSITE face of the PCB.
 *
 * Flipping a Pro Micro footprint onto the other face mirrors the two header
 * rows about the long axis: the pin at left-column index i now lands on the
 * pad that right-column index i used to touch, and vice versa.
 *
 *   idx : normal-left  <->  normal-right
 *    1  : D1 (TX)      <->  RAW
 *    2  : D0 (RX)      <->  GND
 *    3  : GND          <->  RST     <-- see WARNING in the repo notes
 *    4  : GND          <->  VCC     <-- see WARNING in the repo notes
 *    5  : D2           <->  D21/A3
 *    6  : D3           <->  D20/A2
 *    7  : D4           <->  D19/A1
 *    8  : D5           <->  D18/A0
 *    9  : D6           <->  D15
 *   10  : D7           <->  D14
 *   11  : D8           <->  D16
 *   12  : D9           <->  D10
 *
 * Stock shield rows sit on pads D5,D6,D7,D8,D9      -> flipped: D18,D15,D14,D16,D10
 * Stock shield cols sit on pads D19,D18,D15,D14,D16,D10 -> flipped: D4,D5,D6,D7,D8,D9
 */

&kscan0 {
    row-gpios
        = <&pro_micro 18 (GPIO_ACTIVE_HIGH | GPIO_PULL_DOWN)>
        , <&pro_micro 15 (GPIO_ACTIVE_HIGH | GPIO_PULL_DOWN)>
        , <&pro_micro 14 (GPIO_ACTIVE_HIGH | GPIO_PULL_DOWN)>
        , <&pro_micro 16 (GPIO_ACTIVE_HIGH | GPIO_PULL_DOWN)>
        , <&pro_micro 10 (GPIO_ACTIVE_HIGH | GPIO_PULL_DOWN)>
        ;

    col-gpios
        = <&pro_micro 4 GPIO_ACTIVE_HIGH>
        , <&pro_micro 5 GPIO_ACTIVE_HIGH>
        , <&pro_micro 6 GPIO_ACTIVE_HIGH>
        , <&pro_micro 7 GPIO_ACTIVE_HIGH>
        , <&pro_micro 8 GPIO_ACTIVE_HIGH>
        , <&pro_micro 9 GPIO_ACTIVE_HIGH>
        ;
};
